/**
  ******************************************************************************
  * @file    main.c
  * @author  fire
  * @version V1.0
  * @date    2013-xx-xx
  * @brief   测试led
  ******************************************************************************
  * @attention
  *
  * 实验平台:秉火 F103-指南者 STM32 开发板 
  * 论坛    :http://www.firebbs.cn
  * 淘宝    :https://fire-stm32.taobao.com
  *
  ******************************************************************************
  */ 
	
#include "stm32f10x.h"
#include "bsp_led.h"
#include "RTL.h"

#define SOFT_DELAY Delay(0x0FFFFF);

/*
**********************************************************************************************************
											函数声明
**********************************************************************************************************
*/
__task void AppTaskStart(void);
__task void AppTaskLED(void);
__task void AppTaskUserIF(void);
__task void AppTaskMsgPro(void);


static void AppTaskCreate (void);

/*
**********************************************************************************************************
											 变量
**********************************************************************************************************
*/
/* 任务栈空间 */
static uint64_t AppTaskStartStk[256/8];   /* 任务栈 */
static uint64_t AppTaskLEDStk[256/8];     /* 任务栈 */


/* 任务句柄 */
//OS_TID HandleTaskLED = NULL;




/*
*********************************************************************************************************
*	函 数 名: AppTaskCreate
*	功能说明: 创建应用任务
*	形    参: 无
*	返 回 值: 无
*********************************************************************************************************
*/
static void AppTaskCreate (void)
{
	os_tsk_create_user(AppTaskLED,              	/* 任务函数 */ 
	                                   2,                       	/* 任务优先级 */ 
	                                   &AppTaskLEDStk,          	/* 任务栈 */
	                                   sizeof(AppTaskLEDStk));  	/* 任务栈大小，单位字节数 */
	
}


/*
*********************************************************************************************************
*	函 数 名: main
*	功能说明: 标准c程序入口。
*	形    参: 无
*	返 回 值: 无
*********************************************************************************************************
*/
int main (void) 
{	
	/* 初始化外设 */
	NVIC_PriorityGroupConfig(NVIC_PriorityGroup_4);
	SystemCoreClockUpdate();
	LED_GPIO_Config();	 
	
	/* 创建启动任务 */
 	os_sys_init_user (AppTaskStart,             /* 任务函数 */
	                  4,                        /* 任务优先级 */
	                  &AppTaskStartStk,         /* 任务栈 */
	                  sizeof(AppTaskStartStk)); /* 任务栈大小，单位字节数 */
	while(1);
}


/*
*********************************************************************************************************
*	函 数 名: AppTaskStart
*	功能说明: 启动任务，也就是最高优先级任务。
*	形    参: 无
*	返 回 值: 无
*   优 先 级: 2  
*********************************************************************************************************
*/
__task void AppTaskStart(void)
{
	AppTaskCreate();
	
    while(1)
    {
		LED2_ON;		   // 亮
        os_dly_wait(1000);
		LED2_OFF;		   // 灭
		os_dly_wait(1000);
    }
}


/*
*********************************************************************************************************
*	函 数 名: AppTaskLED
*	功能说明: LED闪烁	
*	形    参: 无
*	返 回 值: 无
*   优 先 级: 2  
*********************************************************************************************************
*/
__task void AppTaskLED(void)
{
	const uint16_t ucFrequency = 100;
	os_itv_set(ucFrequency);
	
    while(1)
    {
		LED1_ON;		   // 亮
        os_dly_wait(10);
		LED1_OFF;		   // 灭
		os_dly_wait(10);
    }
}

/*********************************************END OF FILE**********************/
